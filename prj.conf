## prj.conf
```kconfig
#
# Copyright (c) 2019 Nordic Semiconductor ASA
#
# SPDX-License-Identifier: LicenseRef-Nordic-5-Clause
#
CONFIG_NCS_SAMPLES_DEFAULTS=y

CONFIG_BT=y
CONFIG_BT_CENTRAL=y
CONFIG_BT_SMP=y
CONFIG_BT_ATT_TX_COUNT=5
CONFIG_BT_GATT_CLIENT=y
CONFIG_BT_GATT_DM=y
CONFIG_HEAP_MEM_POOL_SIZE=8192
CONFIG_BT_HOGP=y

CONFIG_BT_SCAN=y
CONFIG_BT_SCAN_FILTER_ENABLE=y
CONFIG_BT_SCAN_UUID_CNT=1
CONFIG_BT_PRIVACY=y

CONFIG_MAIN_STACK_SIZE=4096
CONFIG_SYSTEM_WORKQUEUE_STACK_SIZE=8192

CONFIG_BT_SETTINGS=y
CONFIG_FLASH=y
CONFIG_FLASH_PAGE_LAYOUT=y
CONFIG_FLASH_MAP=y

CONFIG_DK_LIBRARY=y

CONFIG_USB_DEVICE_STACK=n
# Enable the New USB Device Stack
CONFIG_USB_DEVICE_STACK_NEXT=y

# Enable HID Class for the New Stack
CONFIG_USB_DEVICE_HID=y

# Set USB Log levels to Debug (this is the key!)
CONFIG_USB_DEVICE_LOG_LEVEL_DBG=y
CONFIG_USBD_LOG_LEVEL_DBG=y
CONFIG_USB_DRIVER_LOG_LEVEL_DBG=y

# Increase log buffer size so messages don't get dropped
CONFIG_LOG_BUFFER_SIZE=4096

# Set the maximum number of simultaneous connections
CONFIG_BT_MAX_CONN=3
CONFIG_BT_MAX_PAIRED=3

# Increase the total number of HOGP instances (one per connection)
#CONFIG_BT_HOGP_MAX_INSTANCES=5
# Increase the total number of report structures across ALL instances
# If a typical mouse/keyboard has 3-5 reports, set this to at least 10-15
CONFIG_BT_HOGP_REPORTS_MAX=25

# This is often the culprit for the slab assertion:
# Increase the GATT Discovery Manager's internal attribute count
# so it can parse multiple services/characteristics at once.
CONFIG_BT_GATT_DM_MAX_ATTRS=50

CONFIG_BT_BUF_CMD_TX_COUNT=10
CONFIG_BT_BUF_EVT_RX_COUNT=10

CONFIG_BT_LOG_LEVEL_INF=y

CONFIG_BT_HCI_TX_STACK_SIZE=4096

CONFIG_BT_RX_STACK_SIZE=4096

CONFIG_FAULT_DUMP=2
CONFIG_RESET_ON_FATAL_ERROR=n

CONFIG_BT_CTLR_ASSERT_HANDLER=y


CONFIG_BT_PERIPHERAL_PREF_MIN_INT=25
CONFIG_BT_PERIPHERAL_PREF_MAX_INT=40

# Prevent the device from forcing a 7.5ms interval automatically
CONFIG_BT_GAP_AUTO_UPDATE_CONN_PARAMS=n

CONFIG_BT_HCI_ACL_FLOW_CONTROL=y

CONFIG_UDC_BUF_POOL_SIZE=20000
```

## app.overlay
```dts
/*
 * Copyright (c) 2023 Nordic Semiconductor ASA
 *
 * SPDX-License-Identifier: Apache-2.0
 */

/ {
	hid_dev_0: hid_dev_0 {
		compatible = "zephyr,hid-device";
		interface-name = "HID0";
		protocol-code = "none";
		in-polling-period-us = <1000>;
		in-report-size = <64>;
	};
	hid_dev_1: hid_dev_1 {
		compatible = "zephyr,hid-device";
		interface-name = "HID1";
		protocol-code = "none";
		in-polling-period-us = <1000>;
		in-report-size = <64>;
	};
};
```

## src/main.c
```c
/* main.c - Application main entry point */

/*
 * Copyright (c) 2018 Nordic Semiconductor ASA
 *
 * SPDX-License-Identifier: LicenseRef-Nordic-5-Clause
 */

#include <zephyr/types.h>
#include <stddef.h>
#include <errno.h>
#include <zephyr/kernel.h>
#include <zephyr/sys/printk.h>

#include <zephyr/bluetooth/bluetooth.h>
#include <zephyr/bluetooth/hci.h>
#include <zephyr/bluetooth/conn.h>
#include <zephyr/bluetooth/uuid.h>
#include <zephyr/bluetooth/gatt.h>
#include <bluetooth/gatt_dm.h>
#include <zephyr/sys/byteorder.h>
#include <bluetooth/scan.h>
#include <bluetooth/services/hogp.h>
#include <dk_buttons_and_leds.h>

#include <zephyr/logging/log.h>

#include <zephyr/usb/usbd.h>
#include <zephyr/usb/class/usbd_hid.h>
#include <zephyr/settings/settings.h>

#include "USB.h"
#include "zephyr/device.h"
#include "main.h"


LOG_MODULE_REGISTER(main, LOG_LEVEL_INF);


/**
 * Switch between boot protocol and report protocol mode.
 */
#define KEY_BOOTMODE_MASK DK_BTN2_MSK
/**
 * Switch CAPSLOCK state.
 *
 * @note
 * For simplicity of the code it works only in boot mode.
 */
#define KEY_CAPSLOCK_MASK DK_BTN1_MSK
/**
 * Switch CAPSLOCK state with response
 *
 * Write CAPSLOCK with response.
 * Just for testing purposes.
 * The result should be the same like usine @ref KEY_CAPSLOCK_MASK
 */
#define KEY_CAPSLOCK_RSP_MASK DK_BTN3_MSK

/* Key used to accept or reject passkey value */
#define KEY_PAIRING_ACCEPT DK_BTN1_MSK
#define KEY_PAIRING_REJECT DK_BTN2_MSK

//static struct bt_conn *default_conn;
//static struct bt_hogp hogp;
static struct bt_conn *auth_conn;
static uint8_t capslock_state;

uint32_t mod = 0;

static void hids_on_ready(struct k_work *work);
static K_WORK_DEFINE(hids_ready_work, hids_on_ready);

#define MAX_HID_DEVICES CONFIG_BT_MAX_CONN



int total_map_finished_dev = 0;

static struct hid_instance devices[MAX_HID_DEVICES];


static void scan_filter_match(struct bt_scan_device_info *device_info,
			      struct bt_scan_filter_match *filter_match,
			      bool connectable)
{
	char addr[BT_ADDR_LE_STR_LEN];

	if (!filter_match->uuid.match ||
	    (filter_match->uuid.count != 1)) {

		printk("Invalid device connected\n");

		return;
	}

	const struct bt_uuid *uuid = filter_match->uuid.uuid[0];

	bt_addr_le_to_str(device_info->recv_info->addr, addr, sizeof(addr));

	printk("Filters matched on UUID 0x%04x.\nAddress: %s connectable: %s\n",
		BT_UUID_16(uuid)->val,
		addr, connectable ? "yes" : "no");
}

static void scan_connecting_error(struct bt_scan_device_info *device_info)
{
	printk("Connecting failed\n");
}

static void scan_connecting(struct bt_scan_device_info *device_info,
			    struct bt_conn *conn)
{
	//default_conn = bt_conn_ref(conn);
	for (int i = 0; i < MAX_HID_DEVICES; i++) {
        if (!devices[i].conn) {
            devices[i].conn = bt_conn_ref(conn);
            printk("Connecting to slot %d...\n", i);
            return;
        }
    }
    printk("No more HID slots available!\n");
}
/** .. include_startingpoint_scan_rst */
static void scan_filter_no_match(struct bt_scan_device_info *device_info,
				 bool connectable)
{
	/*int err;
	struct bt_conn *conn = NULL;
	char addr[BT_ADDR_LE_STR_LEN];

	if (device_info->recv_info->adv_type == BT_GAP_ADV_TYPE_ADV_DIRECT_IND) {
		bt_addr_le_to_str(device_info->recv_info->addr, addr,
				  sizeof(addr));
		printk("Direct advertising received from %s\n", addr);
		bt_scan_stop();

		err = bt_conn_le_create(device_info->recv_info->addr,
					BT_CONN_LE_CREATE_CONN,
					device_info->conn_param, &conn);

		if (!err) {
			default_conn = bt_conn_ref(conn);
			bt_conn_unref(conn);
		}
	}*/
	int err;
    struct bt_conn *conn = NULL;
    char addr[BT_ADDR_LE_STR_LEN];
    int slot = -1;

    // We only care about Direct Advertising for reconnection
    if (device_info->recv_info->adv_type != BT_GAP_ADV_TYPE_ADV_DIRECT_IND) {
        return;
    }

    // 1. Find an available slot in your array
    for (int i = 0; i < MAX_HID_DEVICES; i++) {
        if (devices[i].conn == NULL) {
            slot = i;
            break;
        }
    }

    // If no slots are free, we can't connect to another device
    if (slot == -1) {
        printk("Direct advertising ignored: No free HID slots.\n");
        return;
    }

    bt_addr_le_to_str(device_info->recv_info->addr, addr, sizeof(addr));
    printk("Direct advertising received from %s. Connecting to slot %d...\n", addr, slot);

    // 2. Stop scanning before initiating a manual connection
    bt_scan_stop();

    err = bt_conn_le_create(device_info->recv_info->addr,
                            BT_CONN_LE_CREATE_CONN,
                            device_info->conn_param, 
                            &conn);

    if (err) {
        printk("Create conn failed (err %d). Resuming scan.\n", err);
        bt_scan_start(BT_SCAN_TYPE_SCAN_ACTIVE);
    } else {
        // 3. Store the connection reference in the found slot
        // Note: bt_conn_le_create returns a reference, so we don't need bt_conn_ref()
        // but we do need to unref the local pointer after assignment.
        devices[slot].conn = conn; 
        
        /* The 'connected' callback will now handle security and discovery 
         * using the connection stored in devices[slot]. */
    }
}
/** .. include_endpoint_scan_rst */
BT_SCAN_CB_INIT(scan_cb, scan_filter_match, scan_filter_no_match,
scan_connecting_error, scan_connecting);

static void discovery_completed_cb(struct bt_gatt_dm *dm, void *context)
{
	struct hid_instance *inst = context; 
	int err;

	err = bt_hogp_handles_assign(dm, &inst->hogp);
	if (err) {
		printk("Could not init HIDS client object, error: %d\n", err);
	} else {
		// Trigger the specific work item for THIS device
		k_work_submit(&inst->hids_ready_work);
	}

	bt_gatt_dm_data_release(dm);
	bt_scan_start(BT_SCAN_TYPE_SCAN_ACTIVE);
}

static void discovery_service_not_found_cb(struct bt_conn *conn,
					   void *context)
{
	printk("The service could not be found during the discovery\n");
}

static void discovery_error_found_cb(struct bt_conn *conn,
				     int err,
				     void *context)
{
	printk("The discovery procedure failed with %d\n", err);
}

static const struct bt_gatt_dm_cb discovery_cb = {
	.completed = discovery_completed_cb,
	.service_not_found = discovery_service_not_found_cb,
	.error_found = discovery_error_found_cb,
};
static void gatt_discover(struct bt_conn *conn)
{
    struct hid_instance *inst = NULL;

    // Find which instance matches this connection
    for (int i = 0; i < MAX_HID_DEVICES; i++) {
        if (devices[i].conn == conn) {
            inst = &devices[i];
            break;
        }
    }

    if (!inst) return;

    // Pass the pointer to the instance as context
    int err = bt_gatt_dm_start(conn, BT_UUID_HIDS, &discovery_cb, inst);
    if (err) {
        printk("Discovery error: %d\n", err);
    }
}
static void connected(struct bt_conn *conn, uint8_t conn_err)
{
    int err;
    char addr[BT_ADDR_LE_STR_LEN];
    struct hid_instance *inst = NULL;
    int slot = -1;

    bt_addr_le_to_str(bt_conn_get_dst(conn), addr, sizeof(addr));

    // 1. Find which slot this connection belongs to
    for (int i = 0; i < MAX_HID_DEVICES; i++) {
        if (devices[i].conn == conn) {
            inst = &devices[i];
            slot = i;
            break;
        }
    }

    if (conn_err) {
        printk("Failed to connect to %s, 0x%02x %s\n", addr, conn_err,
               bt_hci_err_to_str(conn_err));

        // If we found the slot, clean it up
        if (inst) {
            bt_conn_unref(inst->conn);
            inst->conn = NULL;
        }

        /* Re-enable scanning so we can try to find other devices or retry */
        err = bt_scan_start(BT_SCAN_TYPE_SCAN_ACTIVE);
        if (err) {
            printk("Scanning failed to start (err %d)\n", err);
        }

        return;
    }

    printk("Connected to slot [%d]: %s\n", slot, addr);

    // 2. Set security for this specific connection
    // HIDS usually requires at least Level 2 (Encryption)
    err = bt_conn_set_security(conn, BT_SECURITY_L2);
    if (err) {
        /* If security fails to initiate (not a security error, but a function error),
         * fall back to discovery. Usually, this happens if security is already met. */
        printk("Failed to initiate security: %d. Starting discovery anyway.\n", err);
        gatt_discover(conn);
    }
    
    /* NOTE: If bt_conn_set_security is successful, the 'security_changed' 
     * callback will be triggered. You should call gatt_discover() there 
     * to ensure the link is encrypted before reading HID data. */
}

static void disconnected(struct bt_conn *conn, uint8_t reason)
{
    char addr[BT_ADDR_LE_STR_LEN];
    int err;
    bool slot_cleared = false;

    bt_addr_le_to_str(bt_conn_get_dst(conn), addr, sizeof(addr));
    printk("Disconnected: %s, reason 0x%02x %s\n", addr, reason, bt_hci_err_to_str(reason));

    // 1. Identify which slot this connection occupied
    for (int i = 0; i < MAX_HID_DEVICES; i++) {
        if (devices[i].conn == conn) {
            
            // 2. Release the HIDS client handles for this specific instance
            if (bt_hogp_assign_check(&devices[i].hogp)) {
                printk("HIDS client in slot [%d] active - releasing\n", i);
                bt_hogp_release(&devices[i].hogp);
            }

            // 3. Cleanup the connection reference
            bt_conn_unref(devices[i].conn);
            devices[i].conn = NULL;
            slot_cleared = true;
            devices[i].subscribed = false; // Reset here!
            break;
        }
    }

    // 4. Handle auth_conn if it matches the disconnecting device
    if (auth_conn == conn) {
        bt_conn_unref(auth_conn);
        auth_conn = NULL;
    }

    // 5. Always attempt to restart scanning
    // This allows the host to find a replacement device for the empty slot.
    err = bt_scan_start(BT_SCAN_TYPE_SCAN_ACTIVE);
    if (err && err != -EALREADY) {
        printk("Scanning failed to start (err %d)\n", err);
    }
}
static void security_changed(struct bt_conn *conn, bt_security_t level,
			     enum bt_security_err err)
{
	char addr[BT_ADDR_LE_STR_LEN];

	bt_addr_le_to_str(bt_conn_get_dst(conn), addr, sizeof(addr));

	if (!err) {
		printk("Security changed: %s level %u\n", addr, level);
	} else {
		printk("Security failed: %s level %u err %d %s\n", addr, level, err,
		       bt_security_err_to_str(err));
	}

	gatt_discover(conn);
}

BT_CONN_CB_DEFINE(conn_callbacks) = {
	.connected        = connected,
	.disconnected     = disconnected,
	.security_changed = security_changed
};

static void scan_init(void)
{
	int err;

	struct bt_scan_init_param scan_init = {
		.connect_if_match = 1,
		.scan_param = NULL,
		.conn_param = BT_LE_CONN_PARAM(6, 8, 0, 400)
	};

	bt_scan_init(&scan_init);
	bt_scan_cb_register(&scan_cb);

	err = bt_scan_filter_add(BT_SCAN_FILTER_TYPE_UUID, BT_UUID_HIDS);
	if (err) {
		printk("Scanning filters cannot be set (err %d)\n", err);

		return;
	}

	err = bt_scan_filter_enable(BT_SCAN_UUID_FILTER, false);
	if (err) {
		printk("Filters cannot be turned on (err %d)\n", err);
	}
}

bool usb_init_succ = 0;

static uint8_t hogp_notify_cb(struct bt_hogp *hogp,
			     struct bt_hogp_rep_info *rep,
			     uint8_t err,
			     const uint8_t *data)
{
	uint8_t size = bt_hogp_rep_size(rep);
	uint8_t i;

	if (!data) {
		return BT_GATT_ITER_STOP;
	}
	int device_idx = -1;
	for(int i = 0; i < MAX_HID_DEVICES; i++)
	{
		if(&devices[i].hogp == hogp)
		{
			device_idx = i;
			break;
		}
	}
	if(usb_init_succ)
	{
		USB_sub_report(device_idx, bt_hogp_rep_id(rep), data, size);
	}
	return BT_GATT_ITER_CONTINUE;
}

static uint8_t hogp_boot_mouse_report(struct bt_hogp *hogp,
				     struct bt_hogp_rep_info *rep,
				     uint8_t err,
				     const uint8_t *data)
{
	uint8_t size = bt_hogp_rep_size(rep);
	uint8_t i;

	if (!data) {
		return BT_GATT_ITER_STOP;
	}
	printk("Notification, mouse boot, size: %u, data:", size);
	for (i = 0; i < size; ++i) {
		printk(" 0x%x", data[i]);
	}
	printk("\n");
	return BT_GATT_ITER_CONTINUE;
}

static uint8_t hogp_boot_kbd_report(struct bt_hogp *hogp,
				   struct bt_hogp_rep_info *rep,
				   uint8_t err,
				   const uint8_t *data)
{
	uint8_t size = bt_hogp_rep_size(rep);
	uint8_t i;

	if (!data) {
		return BT_GATT_ITER_STOP;
	}
	printk("Notification, keyboard boot, size: %u, data:", size);
	for (i = 0; i < size; ++i) {
		printk(" 0x%x", data[i]);
	}
	printk("\n");
	return BT_GATT_ITER_CONTINUE;
}

static void hogp_ready_cb(struct bt_hogp *hogp)
{
    // Find the parent instance that contains this specific hogp struct
    struct hid_instance *inst = CONTAINER_OF(hogp, struct hid_instance, hogp);

    printk("HOGP instance %p is ready, submitting work...\n", inst);

    // Submit the work item for THIS specific device instance
    k_work_submit(&inst->hids_ready_work);
}

uint8_t map[2][512];
int map_size[2];



static void map_cb(struct bt_hogp *hogp, uint8_t err,
                   const uint8_t *data, size_t size, size_t offset)
{

    if (err) {
        printk("Map read failed (err %d)\n", err);
        return;
    }

	int device_idx = -1;
	for(int i = 0; i < MAX_HID_DEVICES; i++)
	{
		if(&devices[i].hogp == hogp)
		{
			device_idx = i;
			break;
		}
	}
	if(device_idx < 0)
	{
		printk("ERROR: DEVICE NOT FOUND\n");
		return;
	}


    // If size is 0 or data is NULL, the device has no more data to send
    if (size == 0 || data == NULL) {
        printk("Full Report Map received!\n");
		//k_work_submit(&usb_init_work);
		devices[device_idx].map_cplt = 1;
		total_map_finished_dev ++;
		struct bt_hogp_rep_info *rep = NULL;
		if (devices[device_idx].subscribed) {
			printk("Instance %p already subscribed, skipping.\n", devices[device_idx]);
			return;
		}
		while (NULL != (rep = bt_hogp_rep_next(hogp, rep))) {
			if (bt_hogp_rep_type(rep) == BT_HIDS_REPORT_TYPE_INPUT) {
				printk("Subscribe to report id: %u for instance %p\n",
					   bt_hogp_rep_id(rep), devices[device_idx]);
				
				err = bt_hogp_rep_subscribe(hogp, rep, hogp_notify_cb);
				if (err) {
					printk("Subscribe error (%d)\n", err);
				}
			}
		}
	
		if (hogp->rep_boot.kbd_inp) {
			printk("Subscribe to boot keyboard report\n");
			err = bt_hogp_rep_subscribe(hogp, hogp->rep_boot.kbd_inp, hogp_boot_kbd_report);
			if (err) { printk("Subscribe error (%d)\n", err); }
		}
	
		if (hogp->rep_boot.mouse_inp) {
			printk("Subscribe to boot mouse report\n");
			err = bt_hogp_rep_subscribe(hogp, hogp->rep_boot.mouse_inp, hogp_boot_mouse_report);
			if (err) { printk("Subscribe error (%d)\n", err); }
		}
		devices[device_idx].subscribed = true;
        return;
    }

    // Print the current chunk
    printk("Chunk at offset %d (size %d):\n", offset, size);
    for (int i = 0; i < size; i++) {
		devices[device_idx].map[devices[device_idx].map_size ++]= data[i];
    }
    printk("\n");

    // TRIGGER THE NEXT CHUNK
    // We increment the offset and ask for the next part
    int next_err = bt_hogp_map_read(hogp, map_cb, offset + size, K_MSEC(100));
    if (next_err) {
        printk("Failed to request next chunk (err %d)\n", next_err);
    }
}

static void hids_on_ready(struct k_work *work)
{
    // Retrieve the specific instance this work belongs to
    struct hid_instance *inst = CONTAINER_OF(work, struct hid_instance, hids_ready_work);
    struct bt_hogp *hogp_ptr = &inst->hogp;
    int err;

    printk("HIDS instance %p is ready to work\n", inst);
    // Use hogp_ptr instead of the global hogp
	err = bt_hogp_map_read(hogp_ptr, map_cb, 0, K_MSEC(100));

	
    printk("HOGP Read MAP result = %d\n", err);

	
}

static void hogp_prep_fail_cb(struct bt_hogp *hogp, int err)
{
	printk("ERROR: HIDS client preparation failed!\n");
}

static void hogp_pm_update_cb(struct bt_hogp *hogp)
{
	printk("Protocol mode updated: %s\n",
	      bt_hogp_pm_get(hogp) == BT_HIDS_PM_BOOT ?
	      "BOOT" : "REPORT");
}


/* HIDS client initialization parameters */
static const struct bt_hogp_init_params hogp_init_params = {
	.ready_cb      = hogp_ready_cb,
	.prep_error_cb = hogp_prep_fail_cb,
	.pm_update_cb  = hogp_pm_update_cb,
};


static void hidc_write_cb(struct bt_hogp *hidc,
			  struct bt_hogp_rep_info *rep,
			  uint8_t err)
{
	printk("Caps lock sent\n");
}



static uint8_t capslock_read_cb(struct bt_hogp *hogp,
			     struct bt_hogp_rep_info *rep,
			     uint8_t err,
			     const uint8_t *data)
{
	if (err) {
		printk("Capslock read error (err: %u)\n", err);
		return BT_GATT_ITER_STOP;
	}
	if (!data) {
		printk("Capslock read - no data\n");
		return BT_GATT_ITER_STOP;
	}
	printk("Received data (size: %u, data[0]: 0x%x)\n",
	       bt_hogp_rep_size(rep), data[0]);

	return BT_GATT_ITER_STOP;
}


static void capslock_write_cb(struct bt_hogp *hogp,
			      struct bt_hogp_rep_info *rep,
			      uint8_t err)
{
	int ret;

	printk("Capslock write result: %u\n", err);

	ret = bt_hogp_rep_read(hogp, rep, capslock_read_cb);
	if (ret) {
		printk("Cannot read capslock value (err: %d)\n", ret);
	}
}





static void auth_passkey_display(struct bt_conn *conn, unsigned int passkey)
{
	char addr[BT_ADDR_LE_STR_LEN];

	bt_addr_le_to_str(bt_conn_get_dst(conn), addr, sizeof(addr));

	printk("Passkey for %s: %06u\n", addr, passkey);
}


static void auth_passkey_confirm(struct bt_conn *conn, unsigned int passkey)
{
	char addr[BT_ADDR_LE_STR_LEN];

	auth_conn = bt_conn_ref(conn);

	bt_addr_le_to_str(bt_conn_get_dst(conn), addr, sizeof(addr));

	printk("Passkey for %s: %06u\n", addr, passkey);

	if (IS_ENABLED(CONFIG_SOC_SERIES_NRF54HX) || IS_ENABLED(CONFIG_SOC_SERIES_NRF54LX)) {
		printk("Press Button 0 to confirm, Button 1 to reject.\n");
	} else {
		printk("Press Button 1 to confirm, Button 2 to reject.\n");
	}
}


static void auth_cancel(struct bt_conn *conn)
{
	char addr[BT_ADDR_LE_STR_LEN];

	bt_addr_le_to_str(bt_conn_get_dst(conn), addr, sizeof(addr));

	printk("Pairing cancelled: %s\n", addr);
}


static void pairing_complete(struct bt_conn *conn, bool bonded)
{
	char addr[BT_ADDR_LE_STR_LEN];

	bt_addr_le_to_str(bt_conn_get_dst(conn), addr, sizeof(addr));

	printk("Pairing completed: %s, bonded: %d\n", addr, bonded);
}


static void pairing_failed(struct bt_conn *conn, enum bt_security_err reason)
{
	char addr[BT_ADDR_LE_STR_LEN];

	bt_addr_le_to_str(bt_conn_get_dst(conn), addr, sizeof(addr));

	printk("Pairing failed conn: %s, reason %d %s\n", addr, reason,
	       bt_security_err_to_str(reason));
}

static struct bt_conn_auth_cb conn_auth_callbacks = {
	.passkey_display = auth_passkey_display,
	.passkey_confirm = auth_passkey_confirm,
	.cancel = auth_cancel,
};

static struct bt_conn_auth_info_cb conn_auth_info_callbacks = {
	.pairing_complete = pairing_complete,
	.pairing_failed = pairing_failed
};


void bt_ctlr_assert_handle(char *x, int len)
{
	printk("BT ERR!\n%s", x);
}
int main(void)
{
	int err;

	printk("Starting Bluetooth Central HIDS sample\n");

	for (int i = 0; i < MAX_HID_DEVICES; i++) {
		k_work_init(&devices[i].hids_ready_work, hids_on_ready);
	}

	for(int i = 0; i < MAX_HID_DEVICES; i++)
	{
		bt_hogp_init(&devices[i].hogp, &hogp_init_params);
	}
	//bt_hogp_init(&hogp, &hogp_init_params);

	err = bt_conn_auth_cb_register(&conn_auth_callbacks);
	if (err) {
		printk("failed to register authorization callbacks.\n");
		return 0;
	}

	err = bt_conn_auth_info_cb_register(&conn_auth_info_callbacks);
	if (err) {
		printk("Failed to register authorization info callbacks.\n");
		return 0;
	}

	err = bt_enable(NULL);
	if (err) {
		printk("Bluetooth init failed (err %d)\n", err);
		return 0;
	}

	printk("Bluetooth initialized\n");

	if (IS_ENABLED(CONFIG_SETTINGS)) {
		settings_load();
	}

	scan_init();


	err = bt_scan_start(BT_SCAN_TYPE_SCAN_ACTIVE);
	if (err) {
		printk("Scanning failed to start (err %d)\n", err);
		return 0;
	}

	printk("Scanning successfully started\n");

	bool usb_first_init = 0;
	int connected_dev_last = 0;
	while(1)
	{
		if(total_map_finished_dev != connected_dev_last)
		{
			connected_dev_last = total_map_finished_dev;
			for(int i = 0; i < MAX_HID_DEVICES; i++)
			{
				if(devices[i].map_cplt)
				{
					printk("MAP DEV %d:\n", i);
					for(int j = 0; j < devices[i].map_size; j++)
					{
						//printk("%02X ", devices[i].map[j]);
						map[i][j] = devices[i].map[j];
						if(j%16 ==0)
						{
							//printk("\n");
						}
					}
					//printk("\n");
					map_size[i] = devices[i].map_size;
				}
			}

			k_work_submit(&usb_init_work);
			//break;
		}
		//if(total_map_finished_dev == 2)	break;
		k_msleep(1000);
	}
	return 0;
}
```

## src/USB.c
```c
#include <zephyr/types.h>
#include <stddef.h>
#include <errno.h>
#include <zephyr/kernel.h>
#include <zephyr/sys/printk.h>
#include <zephyr/logging/log.h>

#include <zephyr/usb/usbd.h>
#include <zephyr/usb/class/usbd_hid.h>
#include <zephyr/settings/settings.h>
static uint32_t kb_duration;
static bool kb_ready;


//struct usbd_context *sample_usbd;
const struct device *hid_dev0;
const struct device *hid_dev1;

#include <zephyr/usb/usbd.h>

#define MY_VID 0x2FE3  // Zephyr testing VID
#define MY_PID 0x0001  // Your custom PID

int ver_num = 0;

/* 1. Define String Descriptors (No sample Kconfig needed!) */
USBD_DESC_LANG_DEFINE(my_lang);
USBD_DESC_MANUFACTURER_DEFINE(my_mfr, "My KVM Project");
USBD_DESC_PRODUCT_DEFINE(my_product, "BLE-USB KVM Bridge");
/* 2. Define Configuration (Full Speed, Self-Powered, 100mA max) */

/* 3. Define the Device Context */
USBD_DEVICE_DEFINE(my_usbd_ctx, 
                   DEVICE_DT_GET(DT_NODELABEL(zephyr_udc0)), 
                   MY_VID, MY_PID);

LOG_MODULE_REGISTER(USB, LOG_LEVEL_INF);

USBD_DESC_CONFIG_DEFINE(fs_cfg_desc, "FS Configuration");
USBD_DESC_CONFIG_DEFINE(hs_cfg_desc, "HS Configuration");

/* doc configuration instantiation start */
static const uint8_t attributes = (IS_ENABLED(CONFIG_SAMPLE_USBD_SELF_POWERED) ?
				   USB_SCD_SELF_POWERED : 0) |
				  (IS_ENABLED(CONFIG_SAMPLE_USBD_REMOTE_WAKEUP) ?
				   USB_SCD_REMOTE_WAKEUP : 0);

/* Full speed configuration */
USBD_CONFIGURATION_DEFINE(sample_fs_config,
    attributes,
    1, &fs_cfg_desc);

/* Align the buffer to 4 bytes (pointer size) */
static uint8_t usb_report_buffer[64] __aligned(4);

int pre_init_usbd(void)
{
    int err;

    /* Add String Descriptors */
    err = usbd_add_descriptor(&my_usbd_ctx, &my_lang);
    err |= usbd_add_descriptor(&my_usbd_ctx, &my_mfr);
    err |= usbd_add_descriptor(&my_usbd_ctx, &my_product);
    if (err) {
        printk("Failed to add descriptors\n");
        return -1;
    }

    /* Add Full Speed Configuration */
    err = usbd_add_configuration(&my_usbd_ctx, USBD_SPEED_FS, &sample_fs_config);
    if (err) {
        printk("Failed to add FS configuration\n");
        return -1;
    }

    /* Register the HID Class specifically! 
     * In the new stack, it is identified as "hid_0" 
     * The last parameter '1' is the configuration number. */
    err = usbd_register_class(&my_usbd_ctx, "hid_0", USBD_SPEED_FS, 1);
    if (err) {
        printk("Failed to register HID class\n");
        return -1;
    }

	err = usbd_register_class(&my_usbd_ctx, "hid_1", USBD_SPEED_FS, 1);
    if (err) {
        printk("Failed to register HID class\n");
        return -1;
    }

    return 0; // Ready for usbd_init()!
}

void teardown_usb(void)
{
    int ret;
    /* 1. Stop the USB stack (stops traffic and pulls DP/DM lines) */

	
    ret = usbd_disable(&my_usbd_ctx);
    if (ret) {
        printk("Failed to disable USB\n");
    }

    /* 2. Uninitialize the stack (frees up stack resources) */
    ret = usbd_shutdown(&my_usbd_ctx); 
    if (ret) {
        printk("Failed to shutdown USB\n");
    }

	ret = usbd_unregister_all_classes(&my_usbd_ctx, USBD_SPEED_FS, 1);
	if(ret)
	{
		printk("USB unregister failed with %d\n", ret);
	}

    if (ret == 0) {
        printk("USB HID fully de-initialized. Ready for reconfiguration.\n");
    }
}

static void kb_iface_ready(const struct device *dev, const bool ready)
{
	LOG_INF("HID device %s interface is %s",
		dev->name, ready ? "ready" : "not ready");
	kb_ready = ready;
}

static int kb_get_report(const struct device *dev,
			 const uint8_t type, const uint8_t id, const uint16_t len,
			 uint8_t *const buf)
{
    LOG_WRN("Host requested len: %u", len); // <--- LOG THIS
	LOG_WRN("Get Report Type %u ID %u", type, id);
	return 4;
}

static int kb_set_report(const struct device *dev,
			 const uint8_t type, const uint8_t id, const uint16_t len,
			 const uint8_t *const buf)
{
	if (type != HID_REPORT_TYPE_OUTPUT) {
		LOG_WRN("Unsupported report type");
		return -ENOTSUP;
	}
	return 0;
}

/* Idle duration is stored but not used to calculate idle reports. */
static void kb_set_idle(const struct device *dev,
			const uint8_t id, const uint32_t duration)
{
	LOG_INF("Set Idle %u to %u", id, duration);
	kb_duration = duration;
}

static uint32_t kb_get_idle(const struct device *dev, const uint8_t id)
{
	LOG_INF("Get Idle %u to %u", id, kb_duration);
	return kb_duration;
}

static void kb_set_protocol(const struct device *dev, const uint8_t proto)
{
	LOG_INF("Protocol changed to %s",
		proto == 0U ? "Boot Protocol" : "Report Protocol");
}

static void kb_output_report(const struct device *dev, const uint16_t len,
			     const uint8_t *const buf)
{
	LOG_HEXDUMP_DBG(buf, len, "o.r.");
	kb_set_report(dev, HID_REPORT_TYPE_OUTPUT, 0U, len, buf);
}


void input_done(const struct device *dev,
    const uint8_t *const report)
{
    //printk("input report done\n");
}

struct hid_device_ops kb_ops = {
	.iface_ready = kb_iface_ready,
	.get_report = kb_get_report,
	.set_report = kb_set_report,
	.set_idle = kb_set_idle,
	.get_idle = kb_get_idle,
	.set_protocol = kb_set_protocol,
	.output_report = kb_output_report,
    .input_report_done = input_done
};


extern uint8_t map[2][512];
extern int map_size[2];


extern bool usb_init_succ;

bool first_init = 1;
/* Outside of your functions */
void prep_usb_handler(struct k_work *work)
{
	if(first_init != 1)
	{
		teardown_usb();
	}
	first_init = 0;
    printk("Starting USB Init for Dual HID Devices...\n");
    int ret;

    /* 1. Get and verify Device 0 */
    hid_dev0 = DEVICE_DT_GET(DT_NODELABEL(hid_dev_0));
    if (!device_is_ready(hid_dev0)) {
        printk("HID Device 0 is not ready\n");
        return;
    }

    /* 2. Get and verify Device 1 */
    hid_dev1 = DEVICE_DT_GET(DT_NODELABEL(hid_dev_1));
    if (!device_is_ready(hid_dev1)) {
        printk("HID Device 1 is not ready\n");
        return;
    }
	ret = hid_device_register(hid_dev0, map[0], map_size[0], &kb_ops);
	if (ret != 0) {
		printk("Failed to register HID Device 0, %d\n", ret);
		return;
	}

    /* 3. Register Device 0 */
    

    /* 4. Register Device 1 */
    /* Note: Ensure map1/kb_ops1 are defined if they differ from device 0 */
    ret = hid_device_register(hid_dev1, map[1], map_size[1], &kb_ops); 
    if (ret != 0) {
        printk("Failed to register HID Device 1, %d\n", ret);
        return;
    }

    /* 5. Global USB Stack Init */
    pre_init_usbd();

	usbd_device_set_bcd_device(&my_usbd_ctx, ver_num ++);
    int err = usbd_init(&my_usbd_ctx);
    if (err) {
        printk("Failed to initialize USB device support\n");
        return;
    }

    ret = usbd_enable(&my_usbd_ctx);
    if (ret) {
        printk("Failed to enable USB device support\n");
        return;
    }

    usb_init_succ = 1;
    printk("USB Dual HID Enabled!\n");
}

K_WORK_DEFINE(usb_init_work, prep_usb_handler);

void USB_sub_report(int dev_id, int report_id, uint8_t *data, int size)
{
    if(kb_ready)
    {
        usb_report_buffer[0] = report_id;
        memcpy(usb_report_buffer + 1, data, size);
		if(dev_id == 0)
		{
			hid_device_submit_report(hid_dev0, size + 1, usb_report_buffer);
		}
		if(dev_id == 1)
		{
			hid_device_submit_report(hid_dev1, size + 1, usb_report_buffer);
		}
	    //hid_device_submit_report(hid_dev, size + 1, usb_report_buffer);
    }
}
```

## src/USB.h
```c
/* Forward declaration of the work item */
#include <stdint.h>
extern struct k_work usb_init_work;
void prep_usb_handler(struct k_work *work);
void USB_sub_report(int dev_id, int report_id, uint8_t *data, int size);
```

## src/main.h
```c
#include "bluetooth/services/hogp.h"
#include <stdbool.h>
struct hid_instance {
    struct bt_conn *conn;
    struct bt_hogp hogp;
    bool busy; // To track if this slot is active
	struct k_work hids_ready_work; // Individual work item per device
	bool subscribed;
	uint8_t map[512];
	int map_size;
	bool map_cplt;
};
```

## src/stitcher.c
```c
#include <stdio.h>
#include <stdlib.h>
#include <string.h>
#include <stdint.h>

#include "main.h"
// --- Configuration ---
#define MAX_DEVICES 10
#define MAX_GLOBAL_REPORT_IDS 255
#define MAX_STITCHED_MAP_SIZE 2048
#define MAX_LOCAL_IDS_PER_DEVICE 16


#include <zephyr/kernel.h>
#include <zephyr/logging/log.h>

LOG_MODULE_REGISTER(hid_stitcher, LOG_LEVEL_INF);

// Use your existing array
extern struct hid_instance devices[CONFIG_BT_MAX_CONN];

// --- Data Structures ---

/**
 * @struct reverse_lookup_entry_t
 * @brief Maps a global report ID back to a specific device and its local report ID.
 */
 typedef struct {
    int device_unique_id; // Using unique_id for easier identification
    uint8_t local_id;     // The original, local report ID from the device's map
} reverse_lookup_entry_t;

/**
 * @struct forward_lookup_entry_t
 * @brief Maps a device's unique ID and local report ID to a global report ID.
 */
 typedef struct {
    int device_unique_id;
    uint8_t local_id;
    uint8_t global_id;
} forward_lookup_entry_t;


/**
 * @struct device_info_t
 * @brief Holds information for a single HID device.
 */
typedef struct {
    uint8_t report_map[512]; // Pointer to the device's original report map
    size_t report_map_size;    // Size of the original report map
    int unique_id;
} device_info_t;

/**
 * @struct stitched_hid_info_t
 * @brief Contains the combined report map and all mapping information.
 */
 typedef struct {
    // The final, combined report map sent to the host
    uint8_t stitched_report_map[MAX_STITCHED_MAP_SIZE];
    size_t stitched_report_map_size;

    // Reverse lookup table: global_id -> {device_unique_id, local_id}
    reverse_lookup_entry_t reverse_lookup_table[MAX_GLOBAL_REPORT_IDS + 1];

    // --- NEW: Forward lookup table ---
    // {device_unique_id, local_id} -> global_id
    forward_lookup_entry_t forward_lookup_table[MAX_GLOBAL_REPORT_IDS];
    uint8_t forward_lookup_count;

    // Counters
    uint8_t next_global_id;
    uint8_t device_count;
} stitched_hid_info_t;


volatile stitched_hid_info_t stitched_info;
extern uint8_t usbTaskId;

// --- Core Functions ---

/**
 * @brief Initializes the stitched HID information structure.
 * @param stitched_info Pointer to the structure to initialize.
 */
void initialize_stitched_info(stitched_hid_info_t* stitched_info) {
    if (!stitched_info) return;
    memset(stitched_info, 0, sizeof(stitched_hid_info_t));
    // Start global IDs from 1, as 0 is often implicit.
    stitched_info->next_global_id = 1;
}


/**
 * @brief Stitches multiple HID report maps into a single map and creates lookup tables.
 *
 * This function iterates through a list of HID devices, parses their report maps,
 * and combines them into one large report map. It reassigns report IDs to a new
 * global namespace to prevent conflicts. It populates both a forward and reverse
 * lookup table.
 *
 * @param devices An array of device_info_t structures for each device to be included.
 * @param num_devices The number of devices in the array.
 * @param stitched_info A pointer to the structure where the final stitched map and lookup info will be stored.
 * @return 0 on success, -1 on failure (e.g., buffer overflow or invalid ID).
 */
 int stitch_hid_report_maps(device_info_t devices[], uint8_t num_devices, stitched_hid_info_t* stitched_info) {
    if (!devices || !stitched_info || num_devices > MAX_DEVICES) {
        return -1;
    }

    initialize_stitched_info(stitched_info);
    stitched_info->device_count = num_devices;

    size_t stitched_map_offset = 0;

    // Process each device
    for (uint8_t i = 0; i < num_devices; ++i) {
        if (devices[i].unique_id == 0) {
            fprintf(stderr, "Error: Device unique_id cannot be 0.\n");
            return -1;
        }

        const uint8_t* local_map = devices[i].report_map;
        size_t local_map_size = devices[i].report_map_size;
        size_t local_map_offset = 0;
        int has_explicit_id = 0;

        // Check if the device's map uses any explicit Report IDs
        for(size_t k = 0; k < local_map_size; ++k) {
            if (local_map[k] == 0x85) { // Report ID tag
                has_explicit_id = 1;
                break;
            }
        }

        // If no explicit ID is found, the whole report is implicitly ID 0.
        // We must assign it a global ID at the start.
        if (!has_explicit_id) {
            if (stitched_info->next_global_id > MAX_GLOBAL_REPORT_IDS ||
                stitched_info->forward_lookup_count >= MAX_GLOBAL_REPORT_IDS) {
                fprintf(stderr, "Error: Exceeded max global report IDs.\n");
                return -1;
            }
            if (stitched_map_offset + 2 > MAX_STITCHED_MAP_SIZE) {
                fprintf(stderr, "Error: Stitched map buffer overflow.\n");
                return -1;
            }
            
            uint8_t global_id = stitched_info->next_global_id++;
            uint8_t local_id = 0; // Implicit local ID is 0
            
            // Add the new global Report ID to the stitched map
            stitched_info->stitched_report_map[stitched_map_offset++] = 0x85; // Report ID Tag
            stitched_info->stitched_report_map[stitched_map_offset++] = global_id;

            // Populate the reverse lookup table
            stitched_info->reverse_lookup_table[global_id].device_unique_id = devices[i].unique_id;
            stitched_info->reverse_lookup_table[global_id].local_id = local_id;

            // --- NEW: Populate the forward lookup table ---
            stitched_info->forward_lookup_table[stitched_info->forward_lookup_count].device_unique_id = devices[i].unique_id;
            stitched_info->forward_lookup_table[stitched_info->forward_lookup_count].local_id = local_id;
            stitched_info->forward_lookup_table[stitched_info->forward_lookup_count].global_id = global_id;
            stitched_info->forward_lookup_count++;
        }

        // Parse the local report map and copy it to the stitched map
        while (local_map_offset < local_map_size) {
            uint8_t item = local_map[local_map_offset];

            // Check for Report ID item (prefix 100001, size 01, type 00 -> 0x85)
            if (item == 0x85) { // Report ID Tag
                if (stitched_info->next_global_id > MAX_GLOBAL_REPORT_IDS ||
                    stitched_info->forward_lookup_count >= MAX_GLOBAL_REPORT_IDS) {
                    fprintf(stderr, "Error: Exceeded max global report IDs.\n");
                    return -1;
                }
                
                local_map_offset++; // Move to the ID value
                if (local_map_offset >= local_map_size) break;

                uint8_t local_id = local_map[local_map_offset];
                uint8_t global_id = stitched_info->next_global_id++;
                
                // Populate the reverse lookup table
                stitched_info->reverse_lookup_table[global_id].device_unique_id = devices[i].unique_id;
                stitched_info->reverse_lookup_table[global_id].local_id = local_id;

                // --- NEW: Populate the forward lookup table ---
                stitched_info->forward_lookup_table[stitched_info->forward_lookup_count].device_unique_id = devices[i].unique_id;
                stitched_info->forward_lookup_table[stitched_info->forward_lookup_count].local_id = local_id;
                stitched_info->forward_lookup_table[stitched_info->forward_lookup_count].global_id = global_id;
                stitched_info->forward_lookup_count++;

                // Copy the Report ID item with the new global ID
                if (stitched_map_offset + 2 > MAX_STITCHED_MAP_SIZE) {
                    fprintf(stderr, "Error: Stitched map buffer overflow.\n");
                    return -1;
                }
                stitched_info->stitched_report_map[stitched_map_offset++] = 0x85;
                stitched_info->stitched_report_map[stitched_map_offset++] = global_id;

            } else {
                // Copy other items directly
                if (stitched_map_offset + 1 > MAX_STITCHED_MAP_SIZE) {
                    fprintf(stderr, "Error: Stitched map buffer overflow.\n");
                    return -1;
                }
                stitched_info->stitched_report_map[stitched_map_offset++] = item;
            }
            local_map_offset++;
        }
    }

    stitched_info->stitched_report_map_size = stitched_map_offset;
    return 0;
}


// --- NEW: Forward lookup function ---
/**
 * @brief Performs a forward lookup to find the global ID for a given device and local ID.
 * @param stitched_info Pointer to the populated stitched information structure.
 * @param device_unique_id The unique ID of the device sending the report.
 * @param local_id The local report ID from that device.
 * @return The corresponding global report ID, or 0 if not found.
 */
 uint8_t get_global_id(const stitched_hid_info_t* stitched_info, int device_unique_id, uint8_t local_id) {
    if (!stitched_info) return 0;

    for (uint8_t i = 0; i < stitched_info->forward_lookup_count; ++i) {
        const forward_lookup_entry_t* entry = &stitched_info->forward_lookup_table[i];
        if (entry->device_unique_id == device_unique_id && entry->local_id == local_id) {
            return entry->global_id;
        }
    }
    return 0; // Return 0 to indicate 'not found'
}



/**
 * @brief Prints the stitched report map in a readable hex format.
 */
void print_stitched_map(const stitched_hid_info_t* stitched_info) {
    printf("--- Stitched HID Report Map (Size: %zu) ---\n", stitched_info->stitched_report_map_size);
    for (size_t i = 0; i < stitched_info->stitched_report_map_size; ++i) {
        printf("0x%02X ", stitched_info->stitched_report_map[i]);
        if ((i + 1) % 16 == 0) {
            printf("\n");
        }
    }
    printf("\n\n");
}

void print_raw_map(const device_info_t* raw_map) {
    printf("--- Raw HID Report Map (Size: %zu) ---\n", raw_map->report_map_size);
    for (size_t i = 0; i < raw_map->report_map_size; ++i) {
        printf("0x%02X ", raw_map->report_map[i]);
        if ((i + 1) % 16 == 0) {
            printf("\n");
        }
    }
    printf("\n\n");
}
/**
 * @brief Prints the reverse lookup table.
 */
void print_reverse_lookup_table(const stitched_hid_info_t* stitched_info) {
    printf("--- Reverse Lookup Table ---\n");
    printf("Global ID | Device UID | Local ID\n");
    printf("----------------------------------\n");
    for (int i = 1; i < stitched_info->next_global_id; ++i) {
        printf("%-9d | %-12d | %-8d\n",
               i,
               stitched_info->reverse_lookup_table[i].device_unique_id,
               stitched_info->reverse_lookup_table[i].local_id);
    }
    printf("\n");
}

// --- NEW: Function to print the forward lookup table ---
void print_forward_lookup_table(const stitched_hid_info_t* stitched_info) {
    printf("--- Forward Lookup Table ---\n");
    printf("Device Unique ID | Local ID | Global ID\n");
    printf("--------------------------------------\n");
    for (int i = 0; i < stitched_info->forward_lookup_count; ++i) {
        const forward_lookup_entry_t* entry = &stitched_info->forward_lookup_table[i];
        printf("%-16d | %-8d | %-9d\n",
               entry->device_unique_id,
               entry->local_id,
               entry->global_id);
    }
    printf("\n");
}

uint8_t device_local_2_global(int dev_unique_id, int local_report_id)
{
    uint8_t found_global_id = get_global_id(&stitched_info, dev_unique_id, local_report_id);
    return found_global_id;
}
uint8_t globalid_2_local_dev_uid(int global_id)
{
    reverse_lookup_entry_t entry = stitched_info.reverse_lookup_table[global_id];
    return entry.device_unique_id;
}
// --- Example Usage ---

int mian(device_info_t* raw_map, int dev_cnt) {
    // Example Mouse Report Map (Implicit Report ID 0, but we will treat it as 1 for clarity in example)
    // For this example, let's pretend it has an explicit ID 1.
    const uint8_t mouse_report_map[] = {
        0x05, 0x01,       // Usage Page (Generic Desktop)
        0x09, 0x02,       // Usage (Mouse)
        0xA1, 0x01,       // Collection (Application)
        0x85, 0x01,       //   Report ID (1)
        0x09, 0x01,       //   Usage (Pointer)
        0xA1, 0x00,       //   Collection (Physical)
        0x05, 0x09,       //     Usage Page (Button)
        0x19, 0x01,       //     Usage Minimum (1)
        0x29, 0x03,       //     Usage Maximum (3)
        0x15, 0x00,       //     Logical Minimum (0)
        0x25, 0x01,       //     Logical Maximum (1)
        0x95, 0x03,       //     Report Count (3)
        0x75, 0x01,       //     Report Size (1)
        0x81, 0x02,       //     Input (Data,Var,Abs)
        0x95, 0x01,       //     Report Count (1)
        0x75, 0x05,       //     Report Size (5)
        0x81, 0x03,       //     Input (Cnst,Var,Abs)
        0x05, 0x01,       //     Usage Page (Generic Desktop)
        0x09, 0x30,       //     Usage (X)
        0x09, 0x31,       //     Usage (Y)
        0x15, 0x81,       //     Logical Minimum (-127)
        0x25, 0x7F,       //     Logical Maximum (127)
        0x75, 0x08,       //     Report Size (8)
        0x95, 0x02,       //     Report Count (2)
        0x81, 0x06,       //     Input (Data,Var,Rel)
        0xC0,             //   End Collection
        0xC0              // End Collection
    };

    // Example Keyboard Report Map (Report IDs 1 and 2)
    const uint8_t keyboard_report_map[] = {
        0x05, 0x01,       // Usage Page (Generic Desktop)
        0x09, 0x06,       // Usage (Keyboard)
        0xA1, 0x01,       // Collection (Application)
        // --- Regular Keys (Report ID 1) ---
        0x85, 0x01,       //   Report ID (1)
        0x05, 0x07,       //   Usage Page (Key Codes)
        0x19, 0xE0,       //   Usage Minimum (224)
        0x29, 0xE7,       //   Usage Maximum (231)
        0x15, 0x00,       //   Logical Minimum (0)
        0x25, 0x01,       //   Logical Maximum (1)
        0x75, 0x01,       //   Report Size (1)
        0x95, 0x08,       //   Report Count (8)
        0x81, 0x02,       //   Input (Data,Var,Abs) - Modifier keys
        0x95, 0x01,       //   Report Count (1)
        0x75, 0x08,       //   Report Size (8)
        0x81, 0x01,       //   Input (Cnst,Ary,Abs) - Reserved
        0x95, 0x06,       //   Report Count (6)
        0x75, 0x08,       //   Report Size (8)
        0x15, 0x00,       //   Logical Minimum (0)
        0x25, 0x65,       //   Logical Maximum (101)
        0x05, 0x07,       //   Usage Page (Key Codes)
        0x19, 0x00,       //   Usage Minimum (0)
        0x29, 0x65,       //   Usage Maximum (101)
        0x81, 0x00,       //   Input (Data,Ary,Abs) - Key array
        // --- Media Keys (Report ID 2) ---
        0x85, 0x02,       //   Report ID (2)
        0x05, 0x0C,       //   Usage Page (Consumer)
        0x09, 0x01,       //   Usage (Consumer Control)
        0xA1, 0x01,       //   Collection (Application)
        0x19, 0x00,       //   Usage Minimum (0)
        0x2A, 0x3C, 0x02, //   Usage Maximum (572)
        0x15, 0x00,       //   Logical Minimum (0)
        0x26, 0x3C, 0x02, //   Logical Maximum (572)
        0x95, 0x01,       //   Report Count (1)
        0x75, 0x10,       //   Report Size (16)
        0x81, 0x00,       //   Input (Data,Ary,Abs)
        0xC0,             //   End Collection
        0xC0              // End Collection
    };

    // Array of devices to stitch
    /*device_info_t devices_to_stitch[2];
    devices_to_stitch[0].report_map = mouse_report_map;
    devices_to_stitch[0].report_map_size = sizeof(mouse_report_map);

    devices_to_stitch[1].report_map = keyboard_report_map;
    devices_to_stitch[1].report_map_size = sizeof(keyboard_report_map);
*/
    // The structure to hold the final result

    for(int i = 0; i < dev_cnt; i++)
    {
        print_raw_map(&raw_map[i]);
    }
    // Perform the stitching
    printf("Stitching HID report maps...\n\n");
    if (stitch_hid_report_maps(raw_map, dev_cnt, &stitched_info) == 0) {
        printf("Stitching successful!\n\n");

        // Print the results
        print_stitched_map(&stitched_info);
        print_reverse_lookup_table(&stitched_info);
        print_forward_lookup_table(&stitched_info);
        // --- Example Reverse Lookup ---
        /*printf("--- Reverse Lookup Example ---\n");
        uint8_t incoming_global_id = 2; // Let's say we receive a report with global ID 2
        
        reverse_lookup_entry_t entry = stitched_info.reverse_lookup_table[incoming_global_id];
        printf("Host received a report with Global ID: %d\n", incoming_global_id);
        printf("This maps to Device Unique ID: %d, with Local ID: %d\n", entry.device_unique_id, entry.local_id);

*/  

    } else {
        fprintf(stderr, "Failed to stitch HID report maps.\n");
    }

    return 0;
}
```

## src/stitcher.h
```c
/**
 * @struct reverse_lookup_entry_t
 * @brief Maps a global report ID back to a specific device and its local report ID.
 */
 #include <stddef.h>
#include <stdint.h>


// --- Configuration ---
#define MAX_DEVICES 10
#define MAX_GLOBAL_REPORT_IDS 255
#define MAX_STITCHED_MAP_SIZE 2048
#define MAX_LOCAL_IDS_PER_DEVICE 16


typedef struct {
    uint8_t device_index; // Index of the device in the main device array
    uint8_t local_id;     // The original, local report ID from the device's map
} reverse_lookup_entry_t;

/**
 * @struct device_info_t
 * @brief Holds information for a single HID device.
 */
typedef struct {
    uint8_t report_map[512]; // Pointer to the device's original report map
    size_t report_map_size;    // Size of the original report map
    int unique_id;
} device_info_t;

/**
 * @struct stitched_hid_info_t
 * @brief Contains the combined report map and all mapping information.
 */
typedef struct {
    // The final, combined report map sent to the host
    uint8_t stitched_report_map[MAX_STITCHED_MAP_SIZE];
    size_t stitched_report_map_size;

    // Reverse lookup table: global_id -> {device_index, local_id}
    reverse_lookup_entry_t reverse_lookup_table[MAX_GLOBAL_REPORT_IDS + 1];

    // Counters
    uint8_t next_global_id;
    uint8_t device_count;
} stitched_hid_info_t;



uint8_t device_local_2_global(int dev_unique_id, int local_report_id);
uint8_t globalid_2_local_dev_uid(int global_id);

int mian(device_info_t* raw_map, int dev_cnt);
```
